/*
  IoTStack Quick Start Template — LED + DHT11
  Toggle the board's own onboard LED from the web, and view temperature/
  humidity (real DHT11, or simulated if you don't have one wired up yet).

  Generated by IoTStack's "Quick Start" template gallery.

  ------------------------------------------------------------------
  REQUIRED LIBRARIES (Arduino IDE > Tools > Manage Libraries):
    - "PubSubClient" by Nick O'Leary
    - "DHT sensor library" by Adafruit   (only needed if SIMULATE_DHT11 is 0)
    - "Adafruit Unified Sensor" by Adafruit (same)
  (TLS support — WiFiClientSecure, configTime — is built into the ESP32
  Arduino core, no extra library needed.)
  ------------------------------------------------------------------
  BEFORE UPLOADING:
    1. Fill in your WiFi SSID and password below.
    2. MQTT_HOST/credentials below were filled in when this file was
       generated from the Quick Start wizard — don't reuse them on
       another device.
    3. This device needs outbound access to UDP/123 (NTP) in addition
       to TCP/8883 (MQTTS) — both are needed before the first connect.
  ------------------------------------------------------------------
*/

#include <WiFi.h>
#include <WiFiClientSecure.h>
#include <PubSubClient.h>
#include <DHT.h>

// ---- WiFi ----
const char* WIFI_SSID = "YOUR_WIFI_SSID";
const char* WIFI_PASSWORD = "YOUR_WIFI_PASSWORD";

// ---- MQTT broker (MQTTS/TLS only — IoTStack devices never use plain MQTT) ----
const char* MQTT_HOST = "__MQTT_HOST__";
const uint16_t MQTT_PORT = 8883;

// ISRG Root X1 (Let's Encrypt) — every IoTStack MQTTS cert chains to
// this. Raw string literal so the base64 body doesn't need manual
// "\n"-per-line escaping.
const char* ROOT_CA = R"EOF(
-----BEGIN CERTIFICATE-----
MIIFazCCA1OgAwIBAgIRAIIQz7DSQONZRGPgu2OCiwAwDQYJKoZIhvcNAQELBQAw
TzELMAkGA1UEBhMCVVMxKTAnBgNVBAoTIEludGVybmV0IFNlY3VyaXR5IFJlc2Vh
cmNoIEdyb3VwMRUwEwYDVQQDEwxJU1JHIFJvb3QgWDEwHhcNMTUwNjA0MTEwNDM4
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emyPxgcYxn/eR44/KJ4EBs+lVDR3veyJm+kXQ99b21/+jh5Xos1AnX5iItreGCc=
-----END CERTIFICATE-----
)EOF";

// ---- Device credentials (filled in for THIS device — keep private) ----
const char* MQTT_CLIENT_ID = "__MQTT_CLIENT_ID__";
const char* MQTT_USERNAME  = "__MQTT_USERNAME__";
const char* MQTT_PASSWORD  = "__MQTT_PASSWORD__";

// ---- Topics ----
const char* TOPIC_TELEMETRY = "devices/__MQTT_CLIENT_ID__/telemetry";
const char* TOPIC_CMD       = "devices/__MQTT_CLIENT_ID__/cmd";
const char* TOPIC_STATUS    = "devices/__MQTT_CLIENT_ID__/status";
const char* TOPIC_EVENT     = "devices/__MQTT_CLIENT_ID__/event";
const char* TOPIC_PING      = "devices/__MQTT_CLIENT_ID__/ping";

// ---- Onboard LED — this IS the controllable "light", not a heartbeat ----
#define LED_PIN __LED_PIN__
#define LED_ACTIVE_LOW __LED_ACTIVE_LOW__
#define LED_TARGET_NAME "led_1" // matches the "Đèn LED" control's binding.target
bool ledState = false;

// ---- DHT11 (real sensor, or simulated so you can try this with just a bare board) ----
#define SIMULATE_DHT11 __SIMULATE_DHT11__
#if !SIMULATE_DHT11
#define DHT_PIN __DHT_PIN__
#define DHT_TYPE DHT11
DHT dht(DHT_PIN, DHT_TYPE);
#endif
const unsigned long TELEMETRY_INTERVAL_MS = 5000;
unsigned long lastTelemetry = 0;

// ---- Application-level heartbeat (PRD §11/§29) — not MQTT PINGREQ ----
const unsigned long PING_INTERVAL_MS = 5000;
unsigned long lastPing = 0;
float simTempC = 24.0;
float simHumidityPct = 55.0;

WiFiClientSecure wifiClient;
PubSubClient mqtt(wifiClient);

void connectWiFi() {
  Serial.print("Connecting to WiFi \"");
  Serial.print(WIFI_SSID);
  Serial.println("\"...");
  WiFi.mode(WIFI_STA);
  WiFi.begin(WIFI_SSID, WIFI_PASSWORD);
  while (WiFi.status() != WL_CONNECTED) {
    delay(300);
    Serial.print(".");
  }
  Serial.print("\nWiFi connected, IP: ");
  Serial.println(WiFi.localIP());
}

void syncTime() {
  // TLS certificate-validity checking needs a roughly-correct clock —
  // an ESP32 has no battery-backed RTC and boots at ~1970, which makes
  // every cert look "not yet valid" until this runs.
  Serial.print("Syncing time via NTP");
  configTime(0, 0, "pool.ntp.org", "time.nist.gov");
  time_t now = time(nullptr);
  while (now < 8 * 3600 * 2) {
    delay(300);
    Serial.print(".");
    now = time(nullptr);
  }
  Serial.println(" done.");
}

void applyLed(bool on) {
  ledState = on;
  bool pinHigh = LED_ACTIVE_LOW ? !on : on;
  digitalWrite(LED_PIN, pinHigh ? HIGH : LOW);
  char payload[64];
  snprintf(payload, sizeof(payload), "{\"target\":\"%s\",\"state\":%s}", LED_TARGET_NAME, on ? "true" : "false");
  mqtt.publish(TOPIC_STATUS, payload);
  Serial.println(payload);
}

void mqttCallback(char* topic, byte* payload, unsigned int length) {
  String body;
  body.reserve(length);
  for (unsigned int i = 0; i < length; i++) body += (char)payload[i];
  Serial.print("Received on ");
  Serial.print(topic);
  Serial.print(": ");
  Serial.println(body);

  // Expected payload (exactly what the dashboard's Control Panel toggle
  // sends): {"command":"set","request_id":"...","data":{"target":"led_1","value":true}}
  // Looks for the "target"/"command" substrings regardless of nesting, so
  // it doesn't care that they're now inside "data".
  if (body.indexOf("\"target\":\"" LED_TARGET_NAME "\"") == -1) return;
  if (body.indexOf("\"command\":\"set\"") == -1) return;
  applyLed(body.indexOf("\"value\":true") != -1);
}

void reconnectMQTT() {
  while (!mqtt.connected()) {
    Serial.print("Connecting to MQTT broker ");
    Serial.print(MQTT_HOST);
    Serial.print(":");
    Serial.print(MQTT_PORT);
    Serial.println(" (TLS)...");
    // Last Will and Testament (PRD §30): registered here, at CONNECT time —
    // the broker publishes it on our behalf on an ungraceful disconnect
    // (network drop, power loss), never on a clean one we trigger ourselves.
    if (mqtt.connect(MQTT_CLIENT_ID, MQTT_USERNAME, MQTT_PASSWORD, TOPIC_EVENT, 1, false, "{\"type\":\"network.disconnected\"}")) {
      Serial.println("MQTT connected.");
      mqtt.subscribe(TOPIC_CMD);
      mqtt.publish(TOPIC_EVENT, "{\"type\":\"boot\"}");
      applyLed(ledState); // report actual current state right after boot (PRD §12)
    } else {
      char errBuf[128];
      wifiClient.lastError(errBuf, sizeof(errBuf));
      Serial.print("MQTT connect failed, rc=");
      Serial.print(mqtt.state());
      Serial.print(" (");
      Serial.print(errBuf);
      Serial.println(") - retrying in 2s");
      delay(2000);
    }
  }
}

void publishTelemetry() {
  float tempC, humidityPct;
#if SIMULATE_DHT11
  // Random-walked, not jumped — reads like a real slow-moving sensor.
  simTempC += (random(-4, 5) / 10.0);
  if (simTempC < 18) simTempC = 18;
  if (simTempC > 30) simTempC = 30;
  simHumidityPct += (random(-10, 11) / 10.0);
  if (simHumidityPct < 30) simHumidityPct = 30;
  if (simHumidityPct > 80) simHumidityPct = 80;
  tempC = simTempC;
  humidityPct = simHumidityPct;
#else
  humidityPct = dht.readHumidity();
  tempC = dht.readTemperature();
  if (isnan(humidityPct) || isnan(tempC)) {
    Serial.println("DHT11 read failed - check wiring/pin.");
    return;
  }
#endif
  char payload[96];
  snprintf(payload, sizeof(payload), "{\"temperature_c\":%.1f,\"humidity_pct\":%.1f}", tempC, humidityPct);
  mqtt.publish(TOPIC_TELEMETRY, payload);
  Serial.println(payload);
}

void setup() {
  Serial.begin(115200);
  pinMode(LED_PIN, OUTPUT);
  digitalWrite(LED_PIN, LED_ACTIVE_LOW ? HIGH : LOW);
#if !SIMULATE_DHT11
  dht.begin();
#endif
  connectWiFi();
  syncTime();
  wifiClient.setCACert(ROOT_CA);
  mqtt.setServer(MQTT_HOST, MQTT_PORT);
  mqtt.setCallback(mqttCallback);
  reconnectMQTT();
}

void loop() {
  if (WiFi.status() != WL_CONNECTED) connectWiFi();
  if (!mqtt.connected()) reconnectMQTT();
  mqtt.loop();

  if (millis() - lastTelemetry >= TELEMETRY_INTERVAL_MS) {
    lastTelemetry = millis();
    publishTelemetry();
  }

  if (millis() - lastPing >= PING_INTERVAL_MS) {
    lastPing = millis();
    mqtt.publish(TOPIC_PING, "{}");
  }
}
